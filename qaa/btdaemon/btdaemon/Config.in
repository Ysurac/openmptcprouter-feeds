## qaa/btdaemon/btdaemon/Config.in
```kconfig
config FEATURE_QCA_IOT_IPQ50XX_SUPPORT
	bool "Enables btdaemon package for ipq50xx"
	depends on TARGET_ipq_ipq50xx || TARGET_ipq_ipq50xx_64
	default no
	select PACKAGE_btdaemon
	help
		Enables btdaemon for IPQ50xx Platform
```

## qaa/hyfi/qca-hyfi-networking/qca-hyd/Config.in
```kconfig
choice
    prompt "Ethernet Speed"
    default HYD_GIGABIT_ETHERNET
    help
        set Ethernet speed

config HYD_GIGABIT_ETHERNET
    bool "Gigabit Ethernet"
    help
        use gigabit ethernet

config HYD_FAST_ETHERNET
    bool "Fast Ethernet"
    help
        use fast ethernet

endchoice

config HYD_WIFI_LOAD_BALANCING
	bool "Enable Wi-Fi Load Balancing Feature"
	default y
	help
	  This enables Wi-Fi load balancing (aka. steering) in hyd

config HYD_SUPPORT_VHT160
	bool "Support VHT 160 MHz"
	depends on PACKAGE_kmod-qca-wifi-akronite-perf||PACKAGE_kmod-qca-wifi-dakota-perf||PACKAGE_kmod-qca-wifi-perf||PACKAGE_kmod-qca-wifi-unified-perf||PACKAGE_kmod-qca-wifi-unified-profile||PACKAGE_kmod-qca-wifi-custc-profile||PACKAGE_kmod-qca-wifi-lowmem-profile||PACKAGE_kmod-qca-wifi-flash_16mb-profile

	default y
	help
	  This enables the HYD support for 160 MHz

config HYD_SUPPORT_CFG80211
	bool "Flag cfg80211 based config layer for HYD"
	depends on PACKAGE_qca-cfg80211
	default y
	help
	  CFG80211 support for HYD

config HYD_SUPPORT_CALLTRACE
        bool "Enable calltrace support for HYD"
        help
          calltrace support for HYD

config HYD_SUPPORT_BREAKPAD
	bool "Enable Breakpad Debugging Support for HYD"
	default y
	help
	  Breakpad Debugging Support for HYD

config SUPPORT_WIFISON_EXT_LIB
	bool "Enable QCA Wifi-SON Extended library"
	default y
	help
	  Extended library support for SON event service in HYD

config HYD_DPP_ONBOARD_ENABLE
        bool "Device Provisioning Protocol for onboarding for EasyMesh Devices"
        default y
        help
          This enables Device Provisioning Protocol for onboarding EasyMesh Devices
```

## qaa/hyfi/qca-son-cli/Config.in
```kconfig
config ENABLE_SON_CLI
    bool "Enable SON_CLI support"
    depends on PACKAGE_kmod-qca-wifi-akronite-perf||PACKAGE_kmod-qca-wifi-dakota-perf||PACKAGE_kmod-qca-wifi-perf||PACKAGE_kmod-qca-wifi-unified-perf||PACKAGE_kmod-qca-wifi-unified-profile||PACKAGE_kmod-qca-wifi-custc-profile||PACKAGE_kmod-qca-wifi-lowmem-profile||PACKAGE_kmod-qca-wifi-flash_16mb-profile
    select PACKAGE_qca-son-cli
    default y
    help
        This enables SON_CLI support
```

## qaa/ieee1905-security/qca-ieee1905-security-config/qca-wsplcd/Config.in
```kconfig
config WSPLCD_SUPPORT_PLC
    bool "Support PLC credential cloning"
    depends on PACKAGE_qca-plc-serv
    default y
    help
        This enables the WSPLCD support for PLC interfaces

config WSPLCD_SUPPORT_CFG80211
        bool "Support cfg80211 config layer for WSPLCD"
        depends on PACKAGE_qca-cfg80211
        default y
        help
            CFG80211 support for WSPLCD

config WSPLCD_SUPPORT_CALLTRACE
        bool "Enable calltrace support for WSPLCD"
        help
            Calltrace support for WSPLCD
```

## qaa/qca-IOT/qca-iot/Config.in
```kconfig
config FEATURE_QCA_IOT
	bool "Enables qca-iot package for QCA402x support"
	depends on !TARGET_ipq_ipq50xx && !TARGET_ipq_ipq50xx_64 && !TARGET_ipq_ipq40xx
	default no
	select PACKAGE_qca-IOT
	help
		Enables qca-IOT for QCA402x support
```

## qaa/qca-lib/libwifisoncfg/Config.in
```kconfig
# LIBWIFISONCFG configs
config LIBCFG80211_SUPPORT
	bool "libwifison CFG80211 support"
	depends on PACKAGE_qca-cfg80211
	default y
	help
		Enable CFG80211 support for libwifisoncfg library

config WIFISON_SUPPORT_ATH10K
	bool "Support ATH10K"
	depends on PACKAGE_kmod-mac80211&&!CONFIG_WIFISON_SUPPORT_QSDK
	default y
	help
		This enables SON Libraries support for Ath10k driver

config WIFISON_SUPPORT_QSDK
	bool "Support QSDK"
	depends on PACKAGE_kmod-qca-wifi-unified-profile||PACKAGE_kmod-qca-wifi-custc-profile||PACKAGE_kmod-qca-wifi-lowmem-profile||PACKAGE_kmod-qca-wifi-akronite-perf||PACKAGE_kmod-qca-wifi-dakota-perf||PACKAGE_kmod-qca-wifi-perf||PACKAGE_kmod-qca-wifi-unified-perf&&!CONFIG_WIFISON_SUPPORT_ATH10K||PACKAGE_kmod-qca-wifi-flash_16mb-profile
	default y
	help
		This enables SON Libraries support for Qualcomm Technologies Inc driver
```

## qaa/qca-son-mem-debug/qca-son-mem-debug/Config.in
```kconfig
config ENABLE_SON_MEMORY_DEBUG
    bool "Enable SON Memory Debugging features"
    select PACKAGE_qca-son-mem-debug
    default y
    help
        This enables SON Memory Debugging features
```

## qaa/qca/net/qca-iface-mgr-10.4/Config.in
```kconfig
# iface configs
config IFACE_SUPPORT_CFG80211
	bool "Support cfg80211 config layer for IFACE mgr"
	depends on PACKAGE_qca-cfg80211
	default y
	help
	  CFG80211 support for Iface manager
```

## qaa/whc/qca-whc-lbd/Config.in
```kconfig
# LBD configs
config LBD_SUPPORT_VHT160
	bool "Support VHT 160 MHz"
	depends on PACKAGE_kmod-qca-wifi-unified-profile||PACKAGE_kmod-qca-wifi-custc-profile||PACKAGE_kmod-qca-wifi-akronite-perf||PACKAGE_kmod-qca-wifi-dakota-perf||PACKAGE_kmod-qca-wifi-perf||PACKAGE_kmod-qca-wifi-unified-perf||PACKAGE_kmod-qca-wifi-lowmem-profile||PACKAGE_kmod-qca-wifi-flash_16mb-profile
	default y
	help
	  This enables the LBD support for 160 MHz

config LBD_SUPPORT_CFG80211
	bool "Support cfg80211 config layer for LBD"
	depends on PACKAGE_qca-cfg80211
	default y
	help
	  CFG80211 support for LBD

config LBD_SUPPORT_ATH10K
	bool "Support ATH10K"
	depends on PACKAGE_kmod-mac80211
	default y
	help
	  This enables the LBD support for Ath10k driver

config LBD_SUPPORT_QSDK
	bool "Support QSDK"
	depends on PACKAGE_kmod-qca-wifi-unified-profile||PACKAGE_kmod-qca-wifi-custc-profile||PACKAGE_kmod-qca-wifi-akronite-perf||PACKAGE_kmod-qca-wifi-dakota-perf||PACKAGE_kmod-qca-wifi-perf||PACKAGE_kmod-qca-wifi-unified-perf||PACKAGE_kmod-qca-wifi-lowmem-profile||PACKAGE_kmod-qca-wifi-flash_16mb-profile
	default y
	help
	  This enables the LBD support for Qualcomm Technologies Inc driver

config LBD_SUPPORT_CALLTRACE
        bool "Enable calltrace support for LBD"
        help
          calltrace support for LBD
```

## shortcut-fe/src/Kconfig
```kconfig
#
# Shortcut forwarding engine
#

config SHORTCUT_FE
	tristate "Shortcut Forwarding Engine"
	depends on NF_CONNTRACK
	default n
	help
	  Shortcut is a fast in-kernel packet forwarding engine.

	  To compile this code as a module, choose M here: the module will be
	  called shortcut-fe.

	  If unsure, say N.
```
